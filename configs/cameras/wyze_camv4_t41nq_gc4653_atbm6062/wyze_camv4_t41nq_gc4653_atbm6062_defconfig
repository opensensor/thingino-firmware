## configs/cameras/wyze_camv4_t41nq_gc4653_atbm6062/wyze_camv4_t41nq_gc4653_atbm6062_defconfig
```kconfig
# NAME: Wyze Cam v4 (T41NQ, GC4653, ATBM6062)
# FRAG: soc-xburst2 toolchain-xburst2 ccache brand rootfs kernel system target uboot ssl
BR2_SENSOR_OS04D10=y
BR2_SOC_INGENIC_T41NQ=y
BR2_PACKAGE_THINGINO_UBOOT_FLASH_CONTROLLER_JZ_SFC=n
BR2_PACKAGE_THINGINO_UBOOT_FLASH_CONTROLLER_SFC0_NOR=y
BR2_LINUX_KERNEL_EXT_THINGINO_KOPT=y
BR2_LINUX_KERNEL_EXT_THINGINO_KOPT_DTS=y
BR2_LINUX_KERNEL_EXT_THINGINO_KOPT_DTS_WYZEC4=y
BR2_AVPU_VPLL=y
BR2_AVPU_CLK_550MHZ=y
BR2_ISP_CLK_VPLL=y
BR2_ISP_CLK_300MHZ=y
BR2_ISP_CLKS_SCLKA=y
BR2_ISP_CLKS_550MHZ=y
BR2_ISP_CLKA_SCLKA=y
BR2_ISP_CLKA_550MHZ=y
BR2_THINGINO_AUDIO=y
BR2_THINGINO_BUTTON=y
BR2_THINGINO_MOTORS=y
BR2_THINGINO_RMEM_22=y
BR2_THINGINO_SDCARD=y
BR2_PACKAGE_THINGINO_KOPT_MMC0=y
BR2_PACKAGE_THINGINO_KOPT_MMC0_PB_4BIT=y
BR2_PACKAGE_THINGINO_KOPT_MMC1=y
BR2_PACKAGE_THINGINO_KOPT_MMC1_PC_4BIT=y
FLASH_SIZE_16=y
BR2_PACKAGE_WIFI=y
BR2_PACKAGE_WIFI_ATBM6062S=y
```

## package/wifi-atbm6062s-custom/Config.in
```kconfig
config BR2_PACKAGE_WIFI_ATBM6062S_CUSTOM
	select BR2_LINUX_KERNEL
	bool "AltoBeam ATBM6062S (Custom Local Build)"
	help
	  Custom local build of ATBM6062S WiFi driver for kernel 4.4 compatibility
```
