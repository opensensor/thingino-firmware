## configs/cameras-exp/wyze_cam4_t41nq_os04d10_atbm6062s/wyze_cam4_t41nq_os04d10_atbm6062s_defconfig
```kconfig
# NAME: Wyze Cam 4 (T41NQ, OS04D10, ATBM6062S)
# FRAG: soc-xburst2 core
BR2_AVPU_CLK_550MHZ=y
BR2_AVPU_SCLKA=y
BR2_INGENIC_SOC_MODEL="t41nq"
BR2_ISP_PARAMS="tx_isp_bringup_level=3 t41_ae_flicker_gib_gain_q10=1024 t41_color_green_correction_q10=0 t41_color_blue_correction_q10=0 t41_ae_flicker_profile=-1"
BR2_LINUX_KERNEL_EXT_THINGINO_KOPT=y
BR2_LINUX_KERNEL_EXT_THINGINO_KOPT_DTS=y
BR2_LINUX_KERNEL_EXT_THINGINO_KOPT_DTS_WYZEV4=y
BR2_PACKAGE_OPEN_TX_ISP_V4L2=y
BR2_PACKAGE_THINGINO_ISP_OPEN=y
BR2_PACKAGE_THINGINO_KOPT_DWC2=y
BR2_PACKAGE_THINGINO_KOPT_DWC2_OTG=y
BR2_PACKAGE_THINGINO_RAPTOR_CONF_IRCUT_IR940_FALSE=y
BR2_PACKAGE_THINGINO_RAPTOR_CONF_IRCUT_NIGHT_GAIN="200000"
BR2_PACKAGE_THINGINO_RAPTOR_CONF_IRCUT_PULSE_MS="100"
BR2_PACKAGE_THINGINO_SECUREBOOP=y
BR2_PACKAGE_THINGINO_STREAMER_RAPTOR=y
BR2_PACKAGE_THINGINO_UBOOT_FLASH_CONTROLLER_JZ_SFC=n
BR2_PACKAGE_THINGINO_UBOOT_FLASH_CONTROLLER_SFC0_NOR=y
BR2_PACKAGE_WIFI=y
BR2_PACKAGE_WIFI_ATBM6062S=y
BR2_SENSOR_1_IQ_FILE="configs/cameras-exp/wyze_cam4_t41nq_os04d10_atbm6062s/os04d10-t41.bin"
BR2_SENSOR_1_NAME="os04d10"
BR2_THINGINO_AUDIO=y
BR2_THINGINO_BUTTON=y
BR2_THINGINO_NMEM_MB=8
BR2_THINGINO_RMEM_MB=20
BR2_THINGINO_SDCARD=y
FLASH_SIZE_MB=16
```

## configs/cameras/wyze_vdb2_t31x_sc301iot_atbm6031/wyze_vdb2_t31x_sc301iot_atbm6031_defconfig
```kconfig
# NAME: Wyze Video Doorbell v2 (T31X, SC301IoT, ATBM6031)
# FRAG: soc-xburst1 core
BR2_AVPU_CLK_600MHZ=y
BR2_INGENIC_SOC_MODEL="t31x"
BR2_ISP_CLK_200MHZ=y
BR2_LINUX_KERNEL_CONFIG_FRAGMENT_FILES="$(BR2_EXTERNAL_THINGINO_PATH)/configs/cameras/wyze_vdb2_t31x_sc301iot_atbm6031/kernel-v4l2.config"
BR2_LINUX_KERNEL_PATCH="$(BR2_EXTERNAL_THINGINO_PATH)/package/all-patches/linux/3.10.14/0012-media-add-thingino-dma-buf-selector.patch"
BR2_PACKAGE_OPEN_TX_ISP_V4L2=y
BR2_PACKAGE_THINGINO_ISP_OPEN=y
BR2_PACKAGE_THINGINO_KOPT_DWC2=y
BR2_PACKAGE_THINGINO_KOPT_DWC2_OTG=y
BR2_PACKAGE_THINGINO_KOPT_MMC0=y
BR2_PACKAGE_THINGINO_KOPT_MMC0_PB_4BIT=y
BR2_PACKAGE_THINGINO_KOPT_MMC1=y
BR2_PACKAGE_THINGINO_KOPT_MMC1_PB_4BIT=y
BR2_PACKAGE_THINGINO_KOPT_MMC=y
BR2_PACKAGE_THINGINO_KOPT_UART=y
BR2_PACKAGE_THINGINO_KOPT_UART_UART0=y
BR2_PACKAGE_THINGINO_STREAMER_RAPTOR=y
BR2_PACKAGE_WIFI=y
BR2_PACKAGE_WIFI_ATBM6031=y
BR2_SENSOR_1_NAME="sc301iot"
BR2_THINGINO_AUDIO=y
BR2_THINGINO_BUTTON=y
BR2_THINGINO_DEV_DOORBELL=y
BR2_THINGINO_DFU=y
BR2_THINGINO_LED_B_GPIO=39
BR2_THINGINO_LED_Y_GPIO=38
BR2_THINGINO_PWM_ENABLE=y
BR2_THINGINO_RMEM_MB=42
BR2_THINGINO_SDCARD=y
FLASH_SIZE_MB=16
```

## package/lightnvr/Config.in
```kconfig
config BR2_PACKAGE_LIGHTNVR
	bool "lightnvr"
	depends on BR2_TOOLCHAIN_HEADERS_AT_LEAST_4_4
	select BR2_PACKAGE_GO2RTC
	select BR2_PACKAGE_HOST_NODEJS
	select BR2_PACKAGE_THINGINO_FFMPEG
	select BR2_PACKAGE_SQLITE
	select BR2_PACKAGE_CJSON
	default n
	help
	  Experimental NVR for Ingenic SoC's.
	  Automatically enables FFmpeg with staging installation
	  and required libraries for CMake-based builds.

config BR2_PACKAGE_LIGHTNVR_SOD
	bool "SOD object detection"
	depends on BR2_PACKAGE_LIGHTNVR
	help
	  Build and install LightNVR's SOD object-detection engine.

config BR2_PACKAGE_LIGHTNVR_SOD_INGENIC_MXU
	bool "Ingenic MXU2/MXU3 acceleration"
	depends on BR2_PACKAGE_LIGHTNVR_SOD
	depends on BR2_mips || BR2_mipsel
	default y
	help
	  Enable runtime-dispatched Ingenic SIMD acceleration for SOD.
```
